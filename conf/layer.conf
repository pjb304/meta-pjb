## conf/layer.conf
```bitbake
# We have a conf and classes directory, add to BBPATH
BBPATH .= ":${LAYERDIR}"

# We have recipes-* directories, add to BBFILES
BBFILES += "${LAYERDIR}/recipes-*/*/*.bb \
	${LAYERDIR}/recipes-*/*/*.bbappend"

BBFILE_COLLECTIONS += "pjb"
BBFILE_PATTERN_pjb = "^${LAYERDIR}/"
BBFILE_PRIORITY_pjb = "6"

hostname_pn-base-files = "pjb-image"
KERNEL_MODULE_AUTOLOAD_append = "tun"
```
